## Documentation/devicetree/bindings/clock/owl2x.txt
```
Actions ATM7029 Clock Management Unit (CMU)

This binding uses the common clock binding:
Documentation/devicetree/bindings/clock/clock-bindings.txt

The Clock Management Unit (CMU) is the Clock and Reset Module controller and
HW module responsible for muxing, gating and setting the rate of clocks.

Required properties :
- compatible : Should be “actions,atm7029-cmu”
- reg : Should contain CMU registers location and length
- clocks : Should contain phandle and clock specifiers for two clocks:
  the 32 KHz “losc’ from the ATC260x companion chip, and the board
  oscillator “hosc" (24 Mhz).
- #clock-cells : Should be 1.
  In clock consumers, this cell represents the clock ID exposed by the
  CMU. The assignments may be found in header file
  <dt-bindings/clock/atm7029-cmu.h>.
- #reset-cells : Should be 1.
  In clock consumers, this cell represents the bit number in the CMU’s
  array of CLK_RST_CONTROLLER_RST_DEVICES_* registers.

Example SoC include file:

/ {
	owl2x_cmu: clock {
		compatible = “actions,owl2x-cmu”;
		reg = <0xb0150000 0x1000>;
		#clock-cells = <1>;
		#reset-cells = <1>;
	};

Example board file:

/ {
	clocks {
		compatible = "simple-bus";
		#address-cells = <1>;
		#size-cells = <0>;

		hosc: clock@0 {
			compatible = "fixed-clock";
			reg = <0>;
			#clock-cells = <0>;
			clock-frequency = <24000000>;
		};

		losc: clock@1 {
			compatible = "fixed-clock";
			reg = <1>;
			#clock-cells = <0>;
			clock-frequency = <32768>;
		};
	};

	&owl2x_cmu {
		clocks = <&losc> <&hosc>;
	};
};
```

## arch/arm/mach-atm702x/Kconfig
```kconfig
config ARCH_ATM702X
	bool "Actions Semiconductor ATM702X SOCs"
	select ARCH_REQUIRE_GPIOLIB
	select CLKSRC_MMIO
	select CLKSRC_OF
	select COMMON_CLK
	select GENERIC_CLOCKEVENTS
	select GENERIC_IRQ_CHIP
	select PINCTRL
	select SPARSE_IRQ
	select ATM702X_TIMER
	select ATM702X_PINCTRL
```

## drivers/video/atm702x/Kconfig
```kconfig
source "drivers/video/actx/act_vout/Kconfig"
source "drivers/video/actx/actfb/Kconfig"
source "drivers/video/actx/act_de/Kconfig"
```

## drivers/video/atm702x/act_vout/Kconfig
```kconfig
menuconfig ACT_VOUT
        tristate "Actions Video Out subsystem support"
        help
	  Actions Video Output Subsystem support. Choose Y or M.
	  If you choose M, the module will be called atm702x_vout
```

## drivers/video/atm702x/actfb/Kconfig
```kconfig
menuconfig ACT_FB
	tristate "Actions framebuffer support"
	depends on FB
	select FB_CFB_FILLRECT
	select FB_CFB_COPYAREA
	select FB_CFB_IMAGEBLIT
	help
	  Framebuffer driver for ATM702X based boards.
```
