/*
 * Copyright (C) 2014
 * Author: B. Mouritsen <bnmguy@gmail.com>
 *
 * This program is free software; you can redistribute it and/or modify
 * it under the terms of the GNU General Public License version 2 as
 * published by the Free Software Foundation.
 */

/dts-v1/;

#include "owl29.dtsi"
#include "owl29-hero2.dtsi"

/ {
	model = "Owl29 Novo 10 Hero II Board";
	compatible = "actions,owl29-hero2", "actions,owl29";

	memory {
		reg = <0x80000000 0x40000000>;
	};
};

&sata {
	status = "okay";
};
